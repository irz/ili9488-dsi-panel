/dts-v1/;

#include "stm32mp157.dtsi"
#include "stm32mp15xd.dtsi"
#include "stm32mp15-pinctrl.dtsi"
#include "stm32mp15xxac-pinctrl.dtsi"
#include "stm32mp15xx-dkx.dtsi"

/{
	model = "STMicroelectronics STM32MP157D-DK1 Discovery Board";
	compatible = "st,stm32mp157d-dk1", "st,stm32mp157";

	aliases {
		ethernet0 = &ethernet0;
	};

	chosen {
		stdout-path = "serial0:115200n8";
	};
};
